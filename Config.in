## Config.in
```kconfig
config CLUI_ASSERT
	bool "Assertion"
	default n
	help
	  Build clui library with internal assertions enabled.

config CLUI_SHELL
	bool "Interactive shell"
	default y
	help
	  Build clui library with support for readline based interactive shell
	  session.

config CLUI_TABLE
	bool "Tabular data"
	default y
	help
	  Build clui library with support for presenting / outputting data
	  according to a tabular format.
```
